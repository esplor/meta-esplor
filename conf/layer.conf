## conf/layer.conf
```bitbake
# We have a conf and classes directory, add to BBPATH
BBPATH .= ":${LAYERDIR}"

# We have recipes-* directories, add to BBFILES
BBFILES += "${LAYERDIR}/recipes-*/*/*.bb \
            ${LAYERDIR}/recipes-*/*/*.bbappend"

BBFILE_COLLECTIONS += "meta-esplor"
BBFILE_PATTERN_meta-esplor = "^${LAYERDIR}/"
BBFILE_PRIORITY_meta-esplor = "6"

LAYERDEPENDS_meta-esplor = "core"
LAYERSERIES_COMPAT_meta-esplor = "walnascar"
```

## wic/sdimage-raspberrypi-data.wks
```
# short-description: Create Raspberry Pi SD card image with data partition
# long-description: Creates a partitioned SD card image for use with
# Raspberry Pi. Boot files in first vfat partition, read-only rootfs,
# and a persistent ext4 data partition for SSH host keys and other state.

part /boot --source bootimg-partition --ondisk mmcblk0 --fstype=vfat --label boot --active --align 4096 --size 100
part / --source rootfs --ondisk mmcblk0 --fstype=ext4 --label root --align 4096 --extra-space 200
part /data --ondisk mmcblk0 --fstype=ext4 --label data --align 4096 --size 128 --fsoptions "defaults,noatime"
```
